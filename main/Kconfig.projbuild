## main/Kconfig.projbuild
```kconfig
menu "Abarth Dashboard - debug"

    config ABARTH_SCROLL_BENCH
        bool "Benchmark FPS con scroll automatico delle Impostazioni"
        default n
        help
            Solo per sviluppo. Dopo l'avvio apre la scheda Impostazioni e fa
            scorrere in automatico l'elenco delle categorie, stampando sul log
            seriale gli FPS reali (frame completi al secondo) per 20 secondi.

    config ABARTH_SCREENSHOT
        bool "Cattura schermate della UI v2 via seriale (debug)"
        default n
        help
            Solo per sviluppo. Dopo l'avvio della UI v2 riempie il data store
            con valori di esempio, mostra ogni pagina e stampa il framebuffer
            (RLE + base64) sulla seriale, da convertire in PNG sul computer.

endmenu
```

## sdkconfig.defaults
```kconfig
# Target
CONFIG_IDF_TARGET="esp32p4"

# Flash
CONFIG_ESPTOOLPY_FLASHSIZE_16MB=y
CONFIG_PARTITION_TABLE_CUSTOM=y
CONFIG_PARTITION_TABLE_CUSTOM_FILENAME="partitions.csv"

# PSRAM
CONFIG_IDF_EXPERIMENTAL_FEATURES=y
CONFIG_SPIRAM=y
CONFIG_SPIRAM_MODE_HEX=y
CONFIG_SPIRAM_SPEED_200M=y
CONFIG_SPIRAM_USE_MALLOC=y
CONFIG_SPIRAM_MALLOC_ALWAYSINTERNAL=4096
CONFIG_SPIRAM_MALLOC_RESERVE_INTERNAL=32768

# LVGL
CONFIG_LV_COLOR_DEPTH_16=y
CONFIG_LV_MEM_CUSTOM=y
CONFIG_LV_DISP_DEF_REFR_PERIOD=16
CONFIG_LV_USE_PERF_MONITOR=y
CONFIG_LV_FONT_MONTSERRAT_8=y
CONFIG_LV_FONT_MONTSERRAT_10=y
CONFIG_LV_FONT_MONTSERRAT_12=y
CONFIG_LV_FONT_MONTSERRAT_14=y
CONFIG_LV_FONT_MONTSERRAT_16=y
CONFIG_LV_FONT_MONTSERRAT_18=y
CONFIG_LV_FONT_MONTSERRAT_20=y
CONFIG_LV_FONT_MONTSERRAT_22=y
CONFIG_LV_FONT_MONTSERRAT_24=y
CONFIG_LV_FONT_MONTSERRAT_26=y
CONFIG_LV_FONT_MONTSERRAT_28=y
CONFIG_LV_FONT_MONTSERRAT_30=y
CONFIG_LV_FONT_MONTSERRAT_32=y
CONFIG_LV_FONT_MONTSERRAT_34=y
CONFIG_LV_FONT_MONTSERRAT_36=y
CONFIG_LV_FONT_MONTSERRAT_38=y
CONFIG_LV_FONT_MONTSERRAT_40=y
CONFIG_LV_FONT_MONTSERRAT_42=y
CONFIG_LV_FONT_MONTSERRAT_44=y
CONFIG_LV_FONT_MONTSERRAT_46=y
CONFIG_LV_FONT_MONTSERRAT_48=y
CONFIG_LV_DPI_DEF=130
CONFIG_LV_LOG_LEVEL_ERROR=y
CONFIG_LV_BUILD_EXAMPLES=n

# esp_hosted (SDIO host mode)
CONFIG_ESP_HOSTED_HOST_INTERFACE_SDIO=y
CONFIG_ESP_SDIO_HOST_CLK=18
CONFIG_ESP_SDIO_HOST_CMD=19
CONFIG_ESP_SDIO_HOST_D0=14
CONFIG_ESP_SDIO_HOST_D1=15
CONFIG_ESP_SDIO_HOST_D2=16
CONFIG_ESP_SDIO_HOST_D3=17
CONFIG_ESP_HOSTED_RESET_PIN=54

# Bluetooth (NimBLE)
CONFIG_BT_ENABLED=y
CONFIG_BT_NIMBLE_ENABLED=y
CONFIG_BT_NIMBLE_MAX_CONNECTIONS=1
CONFIG_BT_NIMBLE_MAX_BONDS=1
CONFIG_BT_NIMBLE_ROLE_CENTRAL=y
CONFIG_BT_NIMBLE_ROLE_PERIPHERAL=n
CONFIG_BT_NIMBLE_ROLE_BROADCASTER=n
CONFIG_BT_NIMBLE_ROLE_OBSERVER=y

# FreeRTOS
CONFIG_FREERTOS_HZ=1000
CONFIG_FREERTOS_TASK_CREATE_ALLOW_EXT_MEM=y

# Log level
CONFIG_LOG_DEFAULT_LEVEL_INFO=y

# Performance
CONFIG_COMPILER_OPTIMIZATION_PERF=y

CONFIG_ESP_PANEL_BOARD_FILE_SKIP=n
CONFIG_ESP_PANEL_DRIVERS_FILE_SKIP=n
CONFIG_ESP_UTILS_CONF_SKIP=n
CONFIG_ESP_PANEL_BOARD_FILE_SKIP=n
CONFIG_ESP_PANEL_DRIVERS_FILE_SKIP=n
CONFIG_ESP_UTILS_CONF_SKIP=n
CONFIG_BT_NIMBLE_TRANSPORT_UART=n
CONFIG_ESP_WIFI_REMOTE_LIBRARY_HOSTED=y
CONFIG_ESP_HOSTED_ENABLE_BT_NIMBLE=y
CONFIG_ESP_HOSTED_NIMBLE_HCI_VHCI=y
CONFIG_ESP_HOSTED_DFLT_TASK_FROM_SPIRAM=n

# FatFS Long File Names (LFN) support
CONFIG_FATFS_LFN_HEAP=y
CONFIG_FATFS_MAX_LFN=255
CONFIG_FATFS_API_ENCODING_UTF_8=y

# PNG image decoding for LVGL
CONFIG_LV_USE_PNG=y
```
